## boards/shields/cygnus_3x6/Kconfig.defconfig
```kconfig
if SHIELD_CYGNUS_3X6_LEFT

config ZMK_KEYBOARD_NAME
    default "Cygnus 3x6"

config ZMK_SPLIT_BLE_ROLE_CENTRAL
    default y

endif

if SHIELD_CYGNUS_3X6_RIGHT

config ZMK_KEYBOARD_NAME
    default "Cygnus 3x6"

endif

if SHIELD_CYGNUS_3X6_LEFT || SHIELD_CYGNUS_3X6_RIGHT

config ZMK_SPLIT
    default y

endif
```

## boards/shields/cygnus_3x6/Kconfig.shield
```kconfig
config SHIELD_CYGNUS_3X6_LEFT
    def_bool $(shields_list_contains,cygnus_3x6_left)

config SHIELD_CYGNUS_3X6_RIGHT
    def_bool $(shields_list_contains,cygnus_3x6_right)
```
